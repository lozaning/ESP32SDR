## main/Kconfig.projbuild
```kconfig
menu "ESP-SDR transport"

    config ESP_SDR_UART_ENABLED
        bool "Burst UART0 I/Q transport"
        depends on IDF_TARGET_ESP32S3
        default y
        help
            Enable the optional USB-to-UART bridge interface.

    config ESP_SDR_UART_BAUD
        int "Burst UART0 I/Q baud rate"
        depends on IDF_TARGET_ESP32S3
        range 115200 3000000
        default 2000000

    config ESP_SDR_UART_TX_PIN
        int "Burst UART0 TX GPIO"
        depends on IDF_TARGET_ESP32S3
        range 0 48
        default 43

    config ESP_SDR_UART_RX_PIN
        int "Burst UART0 RX GPIO"
        depends on IDF_TARGET_ESP32S3
        range 0 48
        default 44

    config ESP_SDR_TX_EXPERIMENTAL
        bool "Experimental ESP32-S3 raw-I/Q transmit feeder"
        depends on IDF_TARGET_ESP32S3
        default y
        help
            Enable the reverse-engineered ESP32-S3 DAC/sample-memory replay
            engine. Exposes finite TXRAW, TXIQ8 and TXRAMP commands over the
            existing burst serial transport.

endmenu
```
